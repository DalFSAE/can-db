VERSION ""

NS_ :

BS_:
BU_: EM TEAM
BO_ 2147485197 Temperature: 8 EM
   SG_ MUX M : 0|2@1+ (1,0) [0|1] "" TEAM
   SG_ Min_Temp : 8|8@1+ (0.5,0) [0|127.5] "degC" TEAM
   SG_ Max_Temp : 16|8@1+ (0.5,0) [0|127.5] "degC" TEAM
   SG_ Temp0 m0 : 24|1@1+ (0.5,0) [0|127.5] "degC" TEAM
   SG_ NumSensors : 2|6@1+ (1,0) [0|31] "" TEAM
   SG_ Temp1 m0 : 25|1@1+ (0.5,0) [0|127.5] "degC" TEAM
   SG_ Temp2 m0 : 26|1@1+ (0.5,0) [0|127.5] "degC" TEAM
   SG_ Temp4 m0 : 27|1@1+ (0.5,0) [0|127.5] "degC" TEAM

BO_ 2147483649 Msg347: 8 EM

CM_ BU_ EM "FSAE Energy Meter";
CM_ BU_ TEAM "Messages recived by Energy Meter";
CM_ BO_ 2147485197 "he temperature message includes a multiplexor signal. The ﬁrst bits of the ﬁrst byte of the message
(the multiplexor) are used to determine the meaning of bytes 3-7.
All temperatures are sent as an unsigned byte with the following scaling. degC = raw * 0.5";
BA_DEF_ BO_ "GenMsgBackgroundColor" STRING ;
BA_DEF_ BO_ "GenMsgForegroundColor" STRING ;
BA_DEF_ BO_ "filterlabeling" INT 0 0;
BA_DEF_DEF_ "GenMsgBackgroundColor" "#ffffff";
BA_DEF_DEF_ "GenMsgForegroundColor" "#000000";
BA_DEF_DEF_ "filterlabeling" 1;
BA_ "GenMsgBackgroundColor" BO_ 2147485197 "#000000";
