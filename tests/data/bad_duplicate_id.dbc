VERSION "0.1"

NS_ :

BS_:

BU_: Vector__XXX

BO_ 100 FirstMessage: 8 Vector__XXX
 SG_ SigA : 0|8@1+ (1,0) [0|255] "" Vector__XXX

BO_ 100 SecondMessage: 8 Vector__XXX
 SG_ SigB : 0|8@1+ (1,0) [1|254] "" Vector__XXX
