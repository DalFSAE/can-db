VERSION "0.1"
NS_ :

BS_:
BU_: Vector__XXX
BO_ 100 TestMessage: 8 Vector__XXX
 SG_ TestSig : 0|8@1+ (1,0) [0|255] "" Vector__XXX
